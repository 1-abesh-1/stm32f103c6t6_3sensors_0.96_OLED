#include "oled.h"
#include <string.h>

extern I2C_HandleTypeDef hi2c1;

/*
 * SSD1306 128x64 Display Buffer
 *
 * 128 columns
 * 64 rows
 * 8 pages
 * 1024 bytes total
 */
static uint8_t OLED_Buffer[OLED_WIDTH * OLED_HEIGHT / 8];

static uint8_t cursor_x = 0;
static uint8_t cursor_y = 0;


/* ----------------------------------------------------------
   Send one command
   ---------------------------------------------------------- */
static void OLED_WriteCommand(uint8_t command)
{
    uint8_t data[2];

    data[0] = 0x00;
    data[1] = command;

    HAL_I2C_Master_Transmit(
        &hi2c1,
        OLED_ADDR,
        data,
        2,
        HAL_MAX_DELAY
    );
}


/* ----------------------------------------------------------
   Send data to OLED
   ---------------------------------------------------------- */
static void OLED_WriteData(uint8_t *data, uint16_t size)
{
    uint8_t buffer[129];

    buffer[0] = 0x40;

    while (size > 0)
    {
        uint16_t chunk;

        if (size > 128)
            chunk = 128;
        else
            chunk = size;

        memcpy(&buffer[1], data, chunk);

        HAL_I2C_Master_Transmit(
            &hi2c1,
            OLED_ADDR,
            buffer,
            chunk + 1,
            HAL_MAX_DELAY
        );

        data += chunk;
        size -= chunk;
    }
}


/* ----------------------------------------------------------
   Initialize SSD1306
   ---------------------------------------------------------- */
void OLED_Init(void)
{
    HAL_Delay(100);

    OLED_WriteCommand(0xAE);    // Display OFF

    OLED_WriteCommand(0x20);    // Memory addressing mode
    OLED_WriteCommand(0x00);    // Horizontal addressing mode

    OLED_WriteCommand(0xB0);    // Page start address

    OLED_WriteCommand(0xC8);    // COM scan direction

    OLED_WriteCommand(0x00);    // Low column address
    OLED_WriteCommand(0x10);    // High column address

    OLED_WriteCommand(0x40);    // Start line address

    OLED_WriteCommand(0x81);    // Contrast
    OLED_WriteCommand(0x7F);

    OLED_WriteCommand(0xA1);    // Segment remap

    OLED_WriteCommand(0xA6);    // Normal display

    OLED_WriteCommand(0xA8);    // Multiplex ratio
    OLED_WriteCommand(0x3F);

    OLED_WriteCommand(0xA4);    // Display follows RAM

    OLED_WriteCommand(0xD3);    // Display offset
    OLED_WriteCommand(0x00);

    OLED_WriteCommand(0xD5);    // Display clock
    OLED_WriteCommand(0x80);

    OLED_WriteCommand(0xD9);    // Pre-charge
    OLED_WriteCommand(0xF1);

    OLED_WriteCommand(0xDA);    // COM pins configuration
    OLED_WriteCommand(0x12);

    OLED_WriteCommand(0xDB);    // VCOMH
    OLED_WriteCommand(0x40);

    OLED_WriteCommand(0x8D);    // Charge pump
    OLED_WriteCommand(0x14);

    OLED_WriteCommand(0xAF);    // Display ON

    OLED_Clear();
    OLED_Update();
}


/* ----------------------------------------------------------
   Clear display buffer
   ---------------------------------------------------------- */
void OLED_Clear(void)
{
    memset(OLED_Buffer, 0, sizeof(OLED_Buffer));

    cursor_x = 0;
    cursor_y = 0;
}


/* ----------------------------------------------------------
   Send buffer to OLED
   ---------------------------------------------------------- */
void OLED_Update(void)
{
    for (uint8_t page = 0; page < 8; page++)
    {
        OLED_WriteCommand(0xB0 + page);

        OLED_WriteCommand(0x00);
        OLED_WriteCommand(0x10);

        OLED_WriteData(
            &OLED_Buffer[OLED_WIDTH * page],
            OLED_WIDTH
        );
    }
}


/* ----------------------------------------------------------
   Set cursor
   ---------------------------------------------------------- */
void OLED_SetCursor(uint8_t x, uint8_t y)
{
    cursor_x = x;
    cursor_y = y;
}


/* ----------------------------------------------------------
   5x7 ASCII FONT
   ----------------------------------------------------------

   Supports:

   Space
   ! " # $ % & ' ( ) * + , - . /
   0-9
   : ; < = > ? @
   A-Z
   [ \ ] ^ _
   ` 
   a-z
   { | } ~

   ASCII range: 0x20 - 0x7E

   Each character is 5 pixels wide.
   One extra blank column is added by OLED_WriteChar().
   ---------------------------------------------------------- */

static const uint8_t Font5x7[95][5] =
{
    /* 0x20 Space */
    {0x00,0x00,0x00,0x00,0x00},

    /* 0x21 ! */
    {0x00,0x00,0x5F,0x00,0x00},

    /* 0x22 " */
    {0x00,0x07,0x00,0x07,0x00},

    /* 0x23 # */
    {0x14,0x7F,0x14,0x7F,0x14},

    /* 0x24 $ */
    {0x24,0x2A,0x7F,0x2A,0x12},

    /* 0x25 % */
    {0x23,0x13,0x08,0x64,0x62},

    /* 0x26 & */
    {0x36,0x49,0x55,0x22,0x50},

    /* 0x27 ' */
    {0x00,0x05,0x03,0x00,0x00},

    /* 0x28 ( */
    {0x00,0x1C,0x22,0x41,0x00},

    /* 0x29 ) */
    {0x00,0x41,0x22,0x1C,0x00},

    /* 0x2A * */
    {0x14,0x08,0x3E,0x08,0x14},

    /* 0x2B + */
    {0x08,0x08,0x3E,0x08,0x08},

    /* 0x2C , */
    {0x00,0x50,0x30,0x00,0x00},

    /* 0x2D - */
    {0x08,0x08,0x08,0x08,0x08},

    /* 0x2E . */
    {0x00,0x60,0x60,0x00,0x00},

    /* 0x2F / */
    {0x20,0x10,0x08,0x04,0x02},

    /* 0x30 0 */
    {0x3E,0x51,0x49,0x45,0x3E},

    /* 0x31 1 */
    {0x00,0x42,0x7F,0x40,0x00},

    /* 0x32 2 */
    {0x42,0x61,0x51,0x49,0x46},

    /* 0x33 3 */
    {0x21,0x41,0x45,0x4B,0x31},

    /* 0x34 4 */
    {0x18,0x14,0x12,0x7F,0x10},

    /* 0x35 5 */
    {0x27,0x45,0x45,0x45,0x39},

    /* 0x36 6 */
    {0x3C,0x4A,0x49,0x49,0x30},

    /* 0x37 7 */
    {0x01,0x71,0x09,0x05,0x03},

    /* 0x38 8 */
    {0x36,0x49,0x49,0x49,0x36},

    /* 0x39 9 */
    {0x06,0x49,0x49,0x29,0x1E},

    /* 0x3A : */
    {0x00,0x36,0x36,0x00,0x00},

    /* 0x3B ; */
    {0x00,0x56,0x36,0x00,0x00},

    /* 0x3C < */
    {0x08,0x14,0x22,0x41,0x00},

    /* 0x3D = */
    {0x14,0x14,0x14,0x14,0x14},

    /* 0x3E > */
    {0x00,0x41,0x22,0x14,0x08},

    /* 0x3F ? */
    {0x02,0x01,0x51,0x09,0x06},

    /* 0x40 @ */
    {0x3E,0x41,0x5D,0x55,0x1E},

    /* 0x41 A */
    {0x7E,0x11,0x11,0x11,0x7E},

    /* 0x42 B */
    {0x7F,0x49,0x49,0x49,0x36},

    /* 0x43 C */
    {0x3E,0x41,0x41,0x41,0x22},

    /* 0x44 D */
    {0x7F,0x41,0x41,0x22,0x1C},

    /* 0x45 E */
    {0x7F,0x49,0x49,0x49,0x41},

    /* 0x46 F */
    {0x7F,0x09,0x09,0x09,0x01},

    /* 0x47 G */
    {0x3E,0x41,0x49,0x49,0x7A},

    /* 0x48 H */
    {0x7F,0x08,0x08,0x08,0x7F},

    /* 0x49 I */
    {0x00,0x41,0x7F,0x41,0x00},

    /* 0x4A J */
    {0x20,0x40,0x41,0x3F,0x01},

    /* 0x4B K */
    {0x7F,0x08,0x14,0x22,0x41},

    /* 0x4C L */
    {0x7F,0x40,0x40,0x40,0x40},

    /* 0x4D M */
    {0x7F,0x02,0x0C,0x02,0x7F},

    /* 0x4E N */
    {0x7F,0x04,0x08,0x10,0x7F},

    /* 0x4F O */
    {0x3E,0x41,0x41,0x41,0x3E},

    /* 0x50 P */
    {0x7F,0x09,0x09,0x09,0x06},

    /* 0x51 Q */
    {0x3E,0x41,0x51,0x21,0x5E},

    /* 0x52 R */
    {0x7F,0x09,0x19,0x29,0x46},

    /* 0x53 S */
    {0x46,0x49,0x49,0x49,0x31},

    /* 0x54 T */
    {0x01,0x01,0x7F,0x01,0x01},

    /* 0x55 U */
    {0x3F,0x40,0x40,0x40,0x3F},

    /* 0x56 V */
    {0x1F,0x20,0x40,0x20,0x1F},

    /* 0x57 W */
    {0x3F,0x40,0x38,0x40,0x3F},

    /* 0x58 X */
    {0x63,0x14,0x08,0x14,0x63},

    /* 0x59 Y */
    {0x07,0x08,0x70,0x08,0x07},

    /* 0x5A Z */
    {0x61,0x51,0x49,0x45,0x43},

    /* 0x5B [ */
    {0x00,0x7F,0x41,0x41,0x00},

    /* 0x5C \ */
    {0x02,0x04,0x08,0x10,0x20},

    /* 0x5D ] */
    {0x00,0x41,0x41,0x7F,0x00},

    /* 0x5E ^ */
    {0x04,0x02,0x01,0x02,0x04},

    /* 0x5F _ */
    {0x40,0x40,0x40,0x40,0x40},

    /* 0x60 ` */
    {0x00,0x01,0x02,0x04,0x00},

    /* 0x61 a */
    {0x20,0x54,0x54,0x54,0x78},

    /* 0x62 b */
    {0x7F,0x48,0x44,0x44,0x38},

    /* 0x63 c */
    {0x38,0x44,0x44,0x44,0x20},

    /* 0x64 d */
    {0x38,0x44,0x44,0x48,0x7F},

    /* 0x65 e */
    {0x38,0x54,0x54,0x54,0x18},

    /* 0x66 f */
    {0x08,0x7E,0x09,0x01,0x02},

    /* 0x67 g */
    {0x0C,0x52,0x52,0x52,0x3E},

    /* 0x68 h */
    {0x7F,0x08,0x04,0x04,0x78},

    /* 0x69 i */
    {0x00,0x44,0x7D,0x40,0x00},

    /* 0x6A j */
    {0x20,0x40,0x44,0x3D,0x00},

    /* 0x6B k */
    {0x7F,0x10,0x28,0x44,0x00},

    /* 0x6C l */
    {0x00,0x41,0x7F,0x40,0x00},

    /* 0x6D m */
    {0x7C,0x04,0x18,0x04,0x78},

    /* 0x6E n */
    {0x7C,0x08,0x04,0x04,0x78},

    /* 0x6F o */
    {0x38,0x44,0x44,0x44,0x38},

    /* 0x70 p */
    {0x7C,0x14,0x14,0x14,0x08},

    /* 0x71 q */
    {0x08,0x14,0x14,0x18,0x7C},

    /* 0x72 r */
    {0x7C,0x08,0x04,0x04,0x08},

    /* 0x73 s */
    {0x48,0x54,0x54,0x54,0x20},

    /* 0x74 t */
    {0x04,0x3F,0x44,0x40,0x20},

    /* 0x75 u */
    {0x3C,0x40,0x40,0x20,0x7C},

    /* 0x76 v */
    {0x1C,0x20,0x40,0x20,0x1C},

    /* 0x77 w */
    {0x3C,0x40,0x30,0x40,0x3C},

    /* 0x78 x */
    {0x44,0x28,0x10,0x28,0x44},

    /* 0x79 y */
    {0x0C,0x50,0x50,0x50,0x3C},

    /* 0x7A z */
    {0x44,0x64,0x54,0x4C,0x44},

    /* 0x7B { */
    {0x00,0x08,0x36,0x41,0x00},

    /* 0x7C | */
    {0x00,0x00,0x7F,0x00,0x00},

    /* 0x7D } */
    {0x00,0x41,0x36,0x08,0x00},

    /* 0x7E ~ */
    {0x08,0x04,0x08,0x10,0x08}
};


/* ----------------------------------------------------------
   Write one character
   ---------------------------------------------------------- */
void OLED_WriteChar(char c)
{
    /*
     * Printable ASCII range:
     * 0x20 = Space
     * 0x7E = ~
     */
    if (c < 0x20 || c > 0x7E)
    {
        return;
    }

    uint8_t index = (uint8_t)c - 0x20;

    /*
     * Move to next line if character
     * would exceed display width.
     */
    if (cursor_x + 6 >= OLED_WIDTH)
    {
        cursor_x = 0;
        cursor_y++;
    }

    /*
     * Wrap vertically.
     */
    if (cursor_y >= 8)
    {
        cursor_y = 0;
    }

    /*
     * Write 5x7 character.
     */
    for (uint8_t i = 0; i < 5; i++)
    {
        OLED_Buffer[
            cursor_y * OLED_WIDTH + cursor_x
        ] = Font5x7[index][i];

        cursor_x++;
    }

    /*
     * One blank column between characters.
     */
    OLED_Buffer[
        cursor_y * OLED_WIDTH + cursor_x
    ] = 0x00;

    cursor_x++;
}


/* ----------------------------------------------------------
   Write string
   ---------------------------------------------------------- */
void OLED_WriteString(const char *str)
{
    while (*str)
    {
        OLED_WriteChar(*str++);
    }
}
